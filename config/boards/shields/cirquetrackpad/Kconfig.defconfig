## config/boards/shields/cirquetrackpad/Kconfig.defconfig
```kconfig
if SHIELD_CIRQUETRACKPAD_LEFT

    config ZMK_KEYBOARD_NAME
        default "Cirque Trackpad"
    
    config ZMK_SPLIT_BLE_ROLE_CENTRAL
        default y

endif

if SHIELD_CIRQUETRACKPAD_LEFT || SHIELD_CIRQUETRACKPAD_RIGHT

config ZMK_SPLIT
    default y

endif
```

## config/boards/shields/cirquetrackpad/Kconfig.shield
```kconfig
config SHIELD_CIRQUETRACKPAD_LEFT
    def_bool $(shields_list_contains,cirquetrackpad_left)
config SHIELD_CIRQUETRACKPAD_RIGHT
    def_bool $(shields_list_contains,cirquetrackpad_right)
```

## config/boards/shields/corne_cirque/Kconfig.defconfig
```kconfig
if SHIELD_CORNE_CIRQUE_RIGHT
    config ZMK_SPLIT_BLE_ROLE_CENTRAL
        default y

endif

if SHIELD_CORNE_CIRQUE_LEFT || SHIELD_CORNE_CIRQUE_RIGHT

    config ZMK_KEYBOARD_NAME
        default "Corne Cirque"

    config ZMK_SPLIT
        default y

    config ZMK_USB
        default y

endif
```

## config/west.yml
```yaml
manifest:
  remotes:
    - name: ALpotato
      url-base: https://github.com/ALpotato
  projects:
     - name: zmk
       remote: ALpotato
       revision: ptdevice-cirque
       import: app/west.yml
  self:
    path: config
```
