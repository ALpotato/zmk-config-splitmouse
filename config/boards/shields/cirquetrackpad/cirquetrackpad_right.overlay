#include "cirquetrackpad.dtsi"

&default_transform {
	col-offset = <3>;
};

&kscan0 {
       col-gpios
            = <&pro_micro 10 GPIO_ACTIVE_HIGH>
            , <&pro_micro 16 GPIO_ACTIVE_HIGH>
            , <&pro_micro 14 GPIO_ACTIVE_HIGH>
            ;
    };

&i2c0 {
	status = "okay";
	sda-pin = <15>;
	scl-pin = <17>;    
 trackpad@2a {
	compatible = "cirque,pinnacle";
	reg = <0x2a>;
	label = "Cirque_Trackpad";
        dr-gpios = <&pro_micro 4 GPIO_ACTIVE_HIGH>;
	    //rotate-90;
	    //sleep;
	    //no-taps;
    };
};
